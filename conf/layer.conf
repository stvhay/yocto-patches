## conf/layer.conf
```bitbake
# We have a conf and classes directory, add to BBPATH
BBPATH .= ":${LAYERDIR}"

# We have recipes-* directories, add to BBFILES
BBFILES += "${LAYERDIR}/recipes-*/*/*.bb \
            ${LAYERDIR}/recipes-*/*/*.bbappend"

BBFILE_COLLECTIONS += "patches"
BBFILE_PATTERN_patches = "^${LAYERDIR}/"
BBFILE_PRIORITY_patches = "6"

LAYERDEPENDS_patches = "core"
LAYERSERIES_COMPAT_patches = "kirkstone"
```
